/****************************************************************************/
/* ファイル名   types3_beep.c                                               */
/* ﾌｧｲﾙ内容     ブザー処理(モータドライブ基板TypeS Ver.3用) Ver1.00         */
/* Date         2011.06.01                                                  */
/* Copyright    ジャパンマイコンカーラリー実行委員会                        */
/****************************************************************************/

/*======================================*/
/* インクルード                         */
/*======================================*/
#include    "sfr_r838a.h"               /* R8C/38A SFRの定義ファイル    */
#include    "types3_beep.h"

/*======================================*/
/* 定数設定                             */
/*======================================*/
#define S_BEEP_BIT      p0_4            /* TypeS基板Ver.3のブザーのビット*/
#define S_BEEP_BIT_DIM  pd0_4           /* 上記の入出力設定ビット       */

/*======================================*/
/* グローバル変数の宣言                 */
/*======================================*/
static int          iBeepTimer;         /* ブザー用タイマ               */
static unsigned int uBeepPattern;       /* ブザーパターン               */
static int          iBeepMode;          /* ブザーの処理状態             */

/************************************************************************/
/* モジュール名 initBeepS                                                */
/* 処理概要     ブザー関連初期化                                        */
/* 引数         なし                                                    */
/* 戻り値       なし                                                    */
/************************************************************************/
void initBeepS( void )
{
    uBeepPattern = 0x0000;
    iBeepTimer   = 0;
    iBeepMode    = 0;
}

/************************************************************************/
/* モジュール名 setBeepPatternS                                         */
/* 処理概要     ブザー出力パターンセット                                */
/* 引数         unsigned int パターン                                   */
/* 戻り値       なし                                                    */
/************************************************************************/
void setBeepPatternS( unsigned int data )
{
    uBeepPattern = data;
    iBeepTimer   = 0;
    iBeepMode    = 1;
}

/************************************************************************/
/* モジュール名 setBeepPatternS                                         */
/* 処理概要     ブザー処理                                              */
/* 引数         なし                                                    */
/* 戻り値       なし                                                    */
/* メモ         この関数を1ms毎に実行してください                       */
/************************************************************************/
void beepProcessS( void )
{
    if( iBeepMode ) {
        if( iBeepTimer % 50 == 0) {
            if( uBeepPattern & 0x8000 ) {
                S_BEEP_BIT = 1;
            } else {
                S_BEEP_BIT = 0;
            }
            uBeepPattern <<= 1;
        }
        iBeepTimer++;
        if( iBeepTimer == 17 * 50 ) {
            S_BEEP_BIT = 0;
            iBeepMode = 0;
        }
    }
}

/************************************************************************/
/* end of file                                                          */
/************************************************************************/

/*
改訂経歴

2011.06.01 Ver.1.00 作成
*/
